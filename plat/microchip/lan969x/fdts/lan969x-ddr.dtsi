// SPDX-License-Identifier: (GPL-2.0+ OR MIT)
/*
 * Copyright (C) 2022 Microchip Technology Inc. and its subsidiaries.
 *
 */

&ddr {
	microchip,mem-name = "lan969x_evb_ddr4 2023-07-18-15:26:07 290d67b12fbf";
	microchip,mem-speed = <2400>;
	microchip,mem-size = <0x38000000>;
	microchip,mem-bus-width = <16>;

	microchip,main-reg = <
		0x00001091	/* crcparctl1 */
		0x00000001	/* dbictl */
		0x00000040	/* dfimisc */
		0x0391820f	/* dfitmg0 */
		0x00040201	/* dfitmg1 */
		0x40400003	/* dfiupd0 */
		0x004000ff	/* dfiupd1 */
		0x003f7f44	/* ecccfg0 */
		0x00020248	/* init0 */
		0x00e80000	/* init1 */
		0x0c340501	/* init3 */
		0x10180200	/* init4 */
		0x00110000	/* init5 */
		0x00000402	/* init6 */
		0x00000c19	/* init7 */
		0x81040010	/* mstr */
		0x00000000	/* pccfg */
		0x00000000	/* pwrctl */
		0x00210020	/* rfshctl0 */
		0x00000000	/* rfshctl3 */
	>;

	microchip,timing-reg = <
		0x17131413	/* dramtmg0 */
		0x0007051b	/* dramtmg1 */
		0x1a000010	/* dramtmg12 */
		0x090b0512	/* dramtmg2 */
		0x0000400c	/* dramtmg3 */
		0x08040409	/* dramtmg4 */
		0x07070404	/* dramtmg5 */
		0x05040c07	/* dramtmg8 */
		0x0003040d	/* dramtmg9 */
		0x07000610	/* odtcfg */
		0x004900d3	/* rfshtmg */
	>;

	microchip,mapping-reg = <
		0x0000001f	/* addrmap0 */
		0x003f0505	/* addrmap1 */
		0x01010100	/* addrmap2 */
		0x13131303	/* addrmap3 */
		0x00001f1f	/* addrmap4 */
		0x04040404	/* addrmap5 */
		0x04040404	/* addrmap6 */
		0x00000f0f	/* addrmap7 */
		0x00003f01	/* addrmap8 */
	>;

	microchip,phy-reg = <
		0x0000040c	/* dcr */
		0x0064401b	/* dsgcr */
		0x8000b0cf	/* dtcr0 */
		0x00010a37	/* dtcr1 */
		0x00c01884	/* dxccr */
		0x000010ba	/* pgcr2 */
		0x00000000	/* schcr1 */
		0x0007bb00	/* zq0pr */
		0x90077700	/* zq1pr */
		0x90007700	/* zq2pr */
		0x00058f00	/* zqcr */
	>;

	microchip,phy_timing-reg = <
		0x0827100a	/* dtpr0 */
		0x28250018	/* dtpr1 */
		0x000701b1	/* dtpr2 */
		0x03000101	/* dtpr3 */
		0x01a50808	/* dtpr4 */
		0x00361009	/* dtpr5 */
		0x4ae25710	/* ptr0 */
		0x74f4950e	/* ptr1 */
		0x00083def	/* ptr2 */
		0x1b192000	/* ptr3 */
		0x1003a000	/* ptr4 */
	>;

};
