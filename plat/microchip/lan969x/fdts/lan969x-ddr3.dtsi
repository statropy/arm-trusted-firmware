// SPDX-License-Identifier: (GPL-2.0+ OR MIT)
/*
 * Copyright (C) 2022 Microchip Technology Inc. and its subsidiaries.
 *
 */

&ddr {
	microchip,mem-name = "lan969x_svb_ddr3 2023-07-25-09:19:52 2511176";
	microchip,mem-speed = <1600>;
	microchip,mem-size = <0x40000000>;
	microchip,mem-bus-width = <16>;

	microchip,main-reg = <
		0x00001000	/* crcparctl1 */
		0x00000001	/* dbictl */
		0x00000040	/* dfimisc */
		0x03878206	/* dfitmg0 */
		0x00040201	/* dfitmg1 */
		0x40400003	/* dfiupd0 */
		0x004000ff	/* dfiupd1 */
		0x003f7f40	/* ecccfg0 */
		0x00020186	/* init0 */
		0x009c0000	/* init1 */
		0x1d700046	/* init3 */
		0x00180000	/* init4 */
		0x00090000	/* init5 */
		0x00000000	/* init6 */
		0x00000000	/* init7 */
		0x01040001	/* mstr */
		0x00000000	/* pccfg */
		0x00000000	/* pwrctl */
		0x00210020	/* rfshctl0 */
		0x00000000	/* rfshctl3 */
	>;

	microchip,timing-reg = <
		0x0c0c0d0e	/* dramtmg0 */
		0x00030314	/* dramtmg1 */
		0x1a000010	/* dramtmg12 */
		0x03050509	/* dramtmg2 */
		0x0000400c	/* dramtmg3 */
		0x06020306	/* dramtmg4 */
		0x04040303	/* dramtmg5 */
		0x03030804	/* dramtmg8 */
		0x0004040d	/* dramtmg9 */
		0x0600060c	/* odtcfg */
		0x00820068	/* rfshtmg */
	>;

	microchip,mapping-reg = <
		0x0000001f	/* addrmap0 */
		0x00040401	/* addrmap1 */
		0x01010100	/* addrmap2 */
		0x13131303	/* addrmap3 */
		0x00001f1f	/* addrmap4 */
		0x04040404	/* addrmap5 */
		0x04040404	/* addrmap6 */
		0x00000f0f	/* addrmap7 */
		0x00003f3f	/* addrmap8 */
	>;

	microchip,phy-reg = <
		0x0000040b	/* dcr */
		0x0064401b	/* dsgcr */
		0x8000b0cf	/* dtcr0 */
		0x00010a37	/* dtcr1 */
		0x00c01884	/* dxccr */
		0x00000aa0	/* pgcr2 */
		0x00000000	/* schcr1 */
		0x0007dd00	/* zq0pr */
		0x0007dd7b	/* zq1pr */
		0x0000dd00	/* zq2pr */
		0x00058e00	/* zqcr */
	>;

	microchip,phy_timing-reg = <
		0x051c0b06	/* dtpr0 */
		0x28180004	/* dtpr1 */
		0x000500d8	/* dtpr2 */
		0x02000101	/* dtpr3 */
		0x00d00814	/* dtpr4 */
		0x00270b06	/* dtpr5 */
		0x32019010	/* ptr0 */
		0x4e200e10	/* ptr1 */
		0x00083def	/* ptr2 */
		0x0d861800	/* ptr3 */
		0x08027000	/* ptr4 */
	>;

};
