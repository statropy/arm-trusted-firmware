/dts-v1/;
/plugin/;

/ {
        fragment@0 {
		target-path = "/";
		__overlay__ {
			model = "Linux RAW Boot for LAN966X";
			chosen {
				bootargs = "console=ttyS0,115200 earlyprintk root=/dev/mmcblk0p4 rw rootwait";
			};
			memory {
				device_type = "memory";
				reg = <0x60200000 0x3fe00000>;
			};
		};
	};
};
